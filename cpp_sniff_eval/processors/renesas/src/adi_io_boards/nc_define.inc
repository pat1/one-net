;------------------------------------------------------------------------
;                                                                       |
;   FILE        :nc_define.inc                                          |
;   DATE        :Wed, Oct 31, 2007                                      |
;   DESCRIPTION :interrupt program.                                     |
;   CPU GROUP   :1B                                                     |
;                                                                       |
;   This file is generated by Renesas Project Generator (Ver.4.8).      |
;                                                                       |
;------------------------------------------------------------------------
; Macro Symbol definition
__STANDARD_IO__    .equ	0	; STANDARD I/O flag definition
__HEAPSIZE__       .equ	0H	; HEEP SIZE definition
__STACKSIZE__      .equ	130H	; STACK SIZE definition
__ISTACKSIZE__     .equ	040H	; INTERRUPT STACK SIZE definition
__VECTOR_ADR__     .equ	0fedcH	; INTERRUPT VECTOR ADDRESS definition
__ROM_TOPADR__     .equ	0C000H	; ROM TOP ADDRESS definition

;------------------------------------------------------------------------
;                                                                       |
;   FILE        :nc_define.inc                                          |
;   DATE        :Tue, Oct 25, 2011                                      |
;   DESCRIPTION :interrupt program.                                     |
;   CPU GROUP   :23                                                     |
;                                                                       |
;   This file is generated by Renesas Project Generator (Ver.4.18).     |
;   NOTE:THIS IS A TYPICAL EXAMPLE.                                     |
;------------------------------------------------------------------------
; Macro Symbol definition
__STANDARD_IO__    .equ	1	; STANDARD I/O flag definition
__HEAPSIZE__       .equ	0H	; HEEP SIZE definition
__STACKSIZE__      .equ	180H	; STACK SIZE definition
__ISTACKSIZE__     .equ	100H	; INTERRUPT STACK SIZE definition
__VECTOR_ADR__     .equ	0fedcH	; INTERRUPT VECTOR ADDRESS definition
__ROM_TOPADR__     .equ	04000H	; ROM TOP ADDRESS definition
